#include "bsp_lcd_st7565.h"
             
const uint8_t LCD_FONT6x8[][6];
const uint8_t LCD_FONT8x16[][16];
                     
static void lcd_send_cmd(uint8_t cmd);
static void lcd_send_dat(const uint8_t *dat_buf, uint16_t dat_len);
static void lcd_set_cursor(uint8_t column, uint8_t page);
static void lcd_6x8_char(uint8_t y, uint8_t x, char ch);
static void lcd_8x16_char(uint8_t y, uint8_t x, char ch);

static void lcd_send_cmd(uint8_t cmd)
{
  HAL_GPIO_WritePin(LCD_DC_GPIO_Port, LCD_DC_Pin, GPIO_PIN_RESET); //发送指令
  HAL_GPIO_WritePin(LCD_CS_GPIO_Port, LCD_CS_Pin, GPIO_PIN_RESET);
  HAL_SPI_Transmit(&BSP_LCD_SPI_INST, &cmd, 1, 200);
  HAL_GPIO_WritePin(LCD_CS_GPIO_Port, LCD_CS_Pin, GPIO_PIN_SET);
}

static void lcd_send_byte(uint8_t byte)
{
  HAL_GPIO_WritePin(LCD_DC_GPIO_Port, LCD_DC_Pin, GPIO_PIN_SET); //发送数据
  HAL_GPIO_WritePin(LCD_CS_GPIO_Port, LCD_CS_Pin, GPIO_PIN_RESET);
  HAL_SPI_Transmit(&BSP_LCD_SPI_INST, &byte, 1, 200);
  HAL_GPIO_WritePin(LCD_CS_GPIO_Port, LCD_CS_Pin, GPIO_PIN_SET);
}

static void lcd_send_bytes(uint8_t *bytes, uint8_t bytes_count)
{
  HAL_GPIO_WritePin(LCD_DC_GPIO_Port, LCD_DC_Pin, GPIO_PIN_SET); //发送数据
  HAL_GPIO_WritePin(LCD_CS_GPIO_Port, LCD_CS_Pin, GPIO_PIN_RESET);
  HAL_SPI_Transmit(&BSP_LCD_SPI_INST, bytes, bytes_count, 200);
  HAL_GPIO_WritePin(LCD_CS_GPIO_Port, LCD_CS_Pin, GPIO_PIN_SET);
}

static void lcd_init_regs(void)
{
  lcd_send_cmd(0xE2);
	HAL_Delay(5);
	lcd_send_cmd(0x2C);		/* 升压步骤1 */
	HAL_Delay(5);
	lcd_send_cmd(0x2E);		/* 升压步骤2 */
	HAL_Delay(5);
	lcd_send_cmd(0x2F);		/* 升压步骤3 */
	HAL_Delay(5);
	lcd_send_cmd(0x26);		/* 粗调对比度，可设置范围20～27 */
	lcd_send_cmd(0x81);		/* 微调对比度 */
	lcd_send_cmd(0x18);		/* 微调对比度的值，可设置范围0～63 */	
	lcd_send_cmd(0xA2);		/* 1/9偏压比(bias) */
	lcd_send_cmd(0xC8);		/* 行扫描顺序：从上到下 */
	lcd_send_cmd(0xA0);		/* 列扫描顺序：从左到右 */
	lcd_send_cmd(0x40);		/* 起始行：从第一行开始 */
}

static void lcd_set_cursor(uint8_t column, uint8_t page)
{
	lcd_send_cmd(0xB0 + page);
	lcd_send_cmd(0x10 + (column >> 4));
	lcd_send_cmd(column & 0x0F);
}

static void lcd_6x8_char(uint8_t y, uint8_t x, char ch)
{	
	lcd_set_cursor(x, y);
	lcd_send_bytes((uint8_t*)&LCD_FONT6x8[(uint8_t)(ch - 32)][0], 6);
}

static void lcd_8x16_char(uint8_t y, uint8_t x, char ch)
{	
	lcd_set_cursor(x, y);
	lcd_send_bytes((uint8_t*)&LCD_FONT8x16[(uint8_t)(ch - 32)][0], 8);
	lcd_set_cursor(x, y + 1);
	lcd_send_bytes((uint8_t*)&LCD_FONT8x16[(uint8_t)(ch - 32)][8], 8);
}

void lcd_clear(void)
{
  uint8_t line_buffer[BSP_LCD_X_PIXELS] = { 0 };
  
  for (uint8_t i = 0; i < BSP_LCD_Y_PIXELS / 8; i ++) {
    lcd_set_cursor(0, i);
    lcd_send_bytes(line_buffer, BSP_LCD_X_PIXELS);
  }
}

void lcd_init(void)
{
  HAL_GPIO_WritePin(LCD_RST_GPIO_Port, LCD_RST_Pin, GPIO_PIN_RESET);
	HAL_Delay(10);
  HAL_GPIO_WritePin(LCD_RST_GPIO_Port, LCD_RST_Pin, GPIO_PIN_SET); //复位LCD
	HAL_Delay(10);
  
  lcd_init_regs(); //初始化寄存器
  
  lcd_clear(); //清屏
  
	lcd_send_cmd(0xAF); // 开显示
}

void lcd_6x8_str(uint8_t y, uint8_t x, const char *str)
{
  while(*str != '\0') {
    if(x > BSP_LCD_X_PIXELS - 6 || *str == '\n') {
      x = 0;
      y ++;
      if(y >= BSP_LCD_Y_PIXELS / 8) {
        break;
      }
    } else if(*str<32 || *str>127) {
      continue;
    }
		
    lcd_6x8_char(y, x, *str);

    x += 6;
    str ++;
  }
}

void lcd_8x16_str(uint8_t y, uint8_t x, const char *str)
{
  while(*str) {
    if(x > BSP_LCD_X_PIXELS - 8 || *str == '\n') {
      x = 0;
      y += 2;
      if(y >= BSP_LCD_Y_PIXELS / 8) {
        break;
      }
		} else if(*str < 32 || *str > 127) {
      continue;
    }

    lcd_8x16_char(y, x, *str);

    x += 8;
    str ++;
	}
}

void lcd_bitmap(uint8_t x0, uint8_t y0, uint8_t x_lenth, uint8_t y_lenth, const uint8_t *bmp_tab)
{
	for(uint8_t y = 0; y < y_lenth; y ++) {
    lcd_set_cursor(x0, y0 + y);
		lcd_send_bytes((uint8_t*)bmp_tab + x_lenth * y, x_lenth);
	}
}

/**
 * @brief 6*8的点阵字库
 * 
 */
const uint8_t LCD_FONT6x8[][6] = {
  {0x00, 0x00, 0x00, 0x00, 0x00, 0x00}, // ' '
  {0x00, 0x00, 0x00, 0x2f, 0x00, 0x00}, // !
  {0x00, 0x00, 0x07, 0x00, 0x07, 0x00}, // "
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  {0x00, 0x00, 0x41, 0x3E, 0x08, 0x00}, // }
};

/**
 * @brief 8*16的点阵字库
 * 
 */
const uint8_t LCD_FONT8x16[][16] = {
  {0x00,0x00,0x00,0x00,0x00,0x00,0x00,0x00,0x00,0x00,0x00,0x00,0x00,0x00,0x00,0x00}, // ' '
  {0x00,0x00,0x00,0xF8,0x00,0x00,0x00,0x00,0x00,0x00,0x00,0x33,0x30,0x00,0x00,0x00}, // !
  {0x00,0x10,0x0C,0x06,0x10,0x0C,0x06,0x00,0x00,0x00,0x00,0x00,0x00,0x00,0x00,0x00}, // "
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  {0x00,0x02,0x02,0x7C,0x80,0x00,0x00,0x00,0x00,0x40,0x40,0x3F,0x00,0x00,0x00,0x00}, // }
};
